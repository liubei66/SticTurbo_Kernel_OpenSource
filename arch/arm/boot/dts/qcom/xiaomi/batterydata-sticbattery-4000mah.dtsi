/* Copyright (c) 2018-2020, The Linux Foundation. All rights reserved.
 * Copyright (C) 2020 Amktiao.
 *
 * This program is free software; you can redistribute it and/or modify
 * it under the terms of the GNU General Public License version 2 and
 * only version 2 as published by the Free Software Foundation.
 *
 * This program is distributed in the hope that it will be useful,
 * but WITHOUT ANY WARRANTY; without even the implied warranty of
 * MERCHANTABILITY or FITNESS FOR A PARTICULAR PURPOSE.  See the
 * GNU General Public License for more details.
 */
 
qcom,sticbattery_4000mah {
	qcom,max-voltage-uv = <4400000>;
	qcom,nom-batt-capacity-mah = <4000>;
	qcom,fg-cc-cv-threshold-mv = <4400>;
	qcom,batt-id-kohm = <68>;
	qcom,battery-beta = <3435>;
	qcom,battery-type = "stic_4000mah";
	qcom,checksum = <0x23EB>;
	qcom,gui-version = "PMI8998GUI - 2.0.0.54";
	qcom,fg-profile-data = [
		66 1F B6 05
		70 0A 9D FC
		E3 83 D6 7C
		DC 80 C6 76
		47 83 C1 62
		DF 7A 98 86
		18 82 20 99
		16 B7 A5 C2
		5D 0F E6 83
		4C 7C 46 80
		6E 75 54 83
		7B 59 91 82
		E8 8E 6C 82
		E8 93 80 B5
		2E C1 52 13
		45 0A F2 5B
		CE 6E 71 FD
		E6 3C 4C 3F
		C6 3A 00 00
		A1 4C 45 3C
		36 43 00 00
		00 00 00 00
		96 70 30 70
		29 50 A4 83
		97 75 55 69
		BC 68 49 82
		D2 74 C4 63
		D7 68 E4 B0
		1E E4 63 F8
		64 A0 71 0C
		28 00 FF 36
		F0 11 30 03
		00 00 00 0C
	];
};
