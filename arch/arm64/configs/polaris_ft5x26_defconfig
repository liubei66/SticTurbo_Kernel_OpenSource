## drivers/soc/Kconfig
```kconfig
menu "SOC (System On Chip) specific Drivers"

source "drivers/soc/bcm/Kconfig"
source "drivers/soc/qcom/Kconfig"

endmenu
```

## fs/f2fs_fbe/Kconfig
```kconfig
config FS_F2FS_FBE
	tristate "FS F2FS Encryption"
	select CRYPTO
	select CRYPTO_AES
	select CRYPTO_CBC
	select CRYPTO_ECB
	select CRYPTO_XTS
	select CRYPTO_CTS
	select CRYPTO_CTR
	select KEYS
```
